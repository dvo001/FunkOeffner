## firmware/sdkconfig.defaults
```kconfig
CONFIG_IDF_TARGET="esp32s2"
CONFIG_TINYUSB_CDC_ENABLED=y
CONFIG_TINYUSB_CDC_COUNT=1
CONFIG_TINYUSB_DESC_USE_ESPRESSIF_VID=y
CONFIG_TINYUSB_DESC_USE_DEFAULT_PID=y
CONFIG_TINYUSB_DESC_MANUFACTURER_STRING="FunkOffner Development"
CONFIG_TINYUSB_DESC_PRODUCT_STRING="FunkOffner USB Prototype"
CONFIG_ESP_CONSOLE_UART_DEFAULT=y
```
